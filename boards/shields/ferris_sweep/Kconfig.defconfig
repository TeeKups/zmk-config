## boards/shields/ferris_sweep/Kconfig.defconfig
```kconfig
if SHIELD_FERRIS_SWEEP_DONGLE

# Name must be less than 16 characters long!
config ZMK_KEYBOARD_NAME
    default "Ferris Sweep"

config ZMK_SPLIT
    default y

config ZMK_SPLIT_ROLE_CENTRAL
    default y

config ZMK_SPLIT_BLE_CENTRAL_PERIPHERALS
    default 2

config BT_MAX_CONN
    default 5

config BT_MAX_PAIRED
    default 5

endif


if SHIELD_FERRIS_SWEEP_LEFT || SHIELD_FERRIS_SWEEP_RIGHT

config ZMK_SPLIT
    default y

config ZMK_SPLIT_ROLE_CENTRAL
    default n

endif
```

## boards/shields/ferris_sweep/Kconfig.shield
```kconfig
config SHIELD_FERRIS_SWEEP_DONGLE
    def_bool $(shields_list_contains,ferris_sweep_dongle)

config SHIELD_FERRIS_SWEEP_LEFT
    def_bool $(shields_list_contains,ferris_sweep_left)

config SHIELD_FERRIS_SWEEP_RIGHT
    def_bool $(shields_list_contains,ferris_sweep_right)
```
